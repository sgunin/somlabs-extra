## conf/bblayers.conf
```bitbake
# POKY_BBLAYERS_CONF_VERSION is increased each time build/conf/bblayers.conf
# changes incompatibly
POKY_BBLAYERS_CONF_VERSION = "2"

BSPDIR := "${@os.path.abspath(os.path.dirname(d.getVar('FILE', True)) + '/../..')}"
BBPATH = "${TOPDIR}"
BBFILES ?= ""

BBLAYERS ?= " \
  ${BSPDIR}/sources/poky/meta \
  ${BSPDIR}/sources/poky/meta-poky \
  ${BSPDIR}/sources/meta-openembedded/meta-oe \
  ${BSPDIR}/sources/meta-openembedded/meta-networking \
  ${BSPDIR}/sources/meta-openembedded/meta-python \
  ${BSPDIR}/sources/meta-openembedded/meta-filesystems \
  ${BSPDIR}/sources/meta-freescale \
  ${BSPDIR}/sources/meta-somlabs \
  ${BSPDIR}/sources/meta-somlabs-extra \
  "
```

## conf/layer.conf
```bitbake
# We have a conf and classes directory, add to BBPATH
BBPATH .= ":${LAYERDIR}"

# We have recipes-* directories, add to BBFILES
BBFILES += "${LAYERDIR}/recipes-*/*/*.bb \
	${LAYERDIR}/recipes-*/*/*.bbappend"

IMAGE_FSTYPES_append = " tar"

BBFILE_COLLECTIONS += "somlabs-extra"
BBFILE_PATTERN_somlabs-extra= "^${LAYERDIR}/"
BBFILE_PRIORITY_somlabs-extra = "11"

LAYERSERIES_COMPAT_somlabs-extra = "warrior"

SOMLABS_EXTRA_ROOT_PWD = "12345678"
```
